## configs/cameras/360_ap1pa3_t31x_gc4653_atbm6031/360_ap1pa3_t31x_gc4653_atbm6031_defconfig
```kconfig
# NAME: 360 AP1PA3 (T31X, GC4653, ATBM6031)
# FRAG: soc-xburst1 core
BR2_INGENIC_SOC_MODEL="t31x"
BR2_ISP_CLK_200MHZ=y
BR2_PACKAGE_THINGINO_KOPT_DWC2=y
BR2_PACKAGE_THINGINO_KOPT_DWC2_OTG=y
BR2_PACKAGE_THINGINO_KOPT_MMC0=y
BR2_PACKAGE_THINGINO_KOPT_MMC0_PB_4BIT=y
BR2_PACKAGE_THINGINO_KOPT_MMC1=y
BR2_PACKAGE_THINGINO_KOPT_MMC1_PA_4BIT=y
# 添加 htop
# === 常用工具 ===
BR2_PACKAGE_HTOP=y
BR2_PACKAGE_SCREEN=y
# 安装网络工具集 (包含 telnet)
BR2_PACKAGE_BUSYBOX_SHOW_OTHERS=y
BR2_PACKAGE_ZIP=y
BR2_PACKAGE_UNZIP=y
BR2_PACKAGE_WGET=y
BR2_PACKAGE_OPENSSL=y
BR2_PACKAGE_CA_CERTIFICATES=y
BR2_PACKAGE_THINGINO_SSL_MBEDTLS=y
# 安装交互式 FTP 客户端
#BR2_PACKAGE_TNFTP=y 没有这个包
# FTP/SFTP 客户端
##BR2_PACKAGE_LFTP=y
##BR2_PACKAGE_LFTP_PROTO_FTP=y
##BR2_PACKAGE_LFTP_PROTO_SFTP=y
# ZeroTier VPN
# BR2_PACKAGE_THINGINO_VPN_WIREGUARD is not set
#BR2_PACKAGE_THINGINO_VPN_ZEROTIER=y
#BR2_INSTALL_LIBSTDCPP=y
#BR2_THINGINO_LIBSTDCPP=y
## ZeroTier VPN
#
BR2_PACKAGE_WIFI=y
BR2_PACKAGE_WIFI_ATBM6031=y
BR2_SENSOR_1_NAME="gc4653"
BR2_SENSOR_1_PARAMS="shvflip=1"
BR2_THINGINO_AUDIO=y
BR2_THINGINO_AUDIO_GPIO=63
BR2_THINGINO_BUTTON=y
BR2_THINGINO_DFU=y
BR2_THINGINO_LED_B_GPIO=51
BR2_THINGINO_LED_G_GPIO=54
BR2_THINGINO_MOTORS=y
BR2_THINGINO_PWM_ENABLE=y
BR2_THINGINO_RMEM_MB=48
BR2_THINGINO_SDCARD=y
FLASH_SIZE_MB=16
```

## configs/cameras/iflytek_xfp301m_t31x_jxq03_rtl8188ftv/iflytek_xfp301m_t31x_jxq03_rtl8188ftv_defconfig
```kconfig
# NAME: iFlytek XFP301-M (T31X, JXQ03, RTL8188FTV)
# FRAG: soc-xburst1 core
BR2_INGENIC_SOC_MODEL="t31x"
BR2_PACKAGE_THINGINO_KOPT_MMC0=y
BR2_PACKAGE_THINGINO_KOPT_MMC0_PB_4BIT=y
BR2_PACKAGE_WIFI=y
BR2_PACKAGE_WIFI_RTL8188FU=y
# 添加 htop
# === 常用工具 ===
BR2_PACKAGE_HTOP=y
BR2_PACKAGE_SCREEN=y
# 安装网络工具集 (包含 telnet)
BR2_PACKAGE_BUSYBOX_SHOW_OTHERS=y
BR2_PACKAGE_ZIP=y
BR2_PACKAGE_UNZIP=y
BR2_PACKAGE_WGET=y
BR2_PACKAGE_OPENSSL=y
BR2_PACKAGE_CA_CERTIFICATES=y
BR2_PACKAGE_THINGINO_SSL_MBEDTLS=y
# 安装交互式 FTP 客户端
#BR2_PACKAGE_TNFTP=y 没有这个包
# FTP/SFTP 客户端
##BR2_PACKAGE_LFTP=y
##BR2_PACKAGE_LFTP_PROTO_FTP=y
##BR2_PACKAGE_LFTP_PROTO_SFTP=y
# ZeroTier VPN
# BR2_PACKAGE_THINGINO_VPN_WIREGUARD is not set
#BR2_PACKAGE_THINGINO_VPN_ZEROTIER=y
#BR2_INSTALL_LIBSTDCPP=y
#BR2_THINGINO_LIBSTDCPP=y
## ZeroTier VPN
BR2_SENSOR_1_NAME="jxq03"
BR2_THINGINO_AUDIO=y
BR2_THINGINO_BUTTON=y
BR2_THINGINO_LED_G_ACTIVE_LOW=y
BR2_THINGINO_LED_G_GPIO=16
BR2_THINGINO_LED_R_ACTIVE_LOW=y
BR2_THINGINO_LED_R_GPIO=17
BR2_THINGINO_MOTORS=y
BR2_THINGINO_RMEM_MB=48
BR2_THINGINO_SDCARD=y
FLASH_SIZE_MB=16
```

## configs/cameras/xiaomi_xiaofang_t20l_jxf23_rtl8189ftv/xiaomi_xiaofang_t20l_jxf23_rtl8189ftv_defconfig
```kconfig
# NAME: Xiaomi Xiaofang iSC5 (T20L, JXF23, RTL8189FTV)
# FRAG: soc-xburst1 core
BR2_INGENIC_SOC_MODEL="t20l"
BR2_PACKAGE_THINGINO_KOPT_DWC2=y
BR2_PACKAGE_THINGINO_KOPT_DWC2_OTG=y
BR2_PACKAGE_THINGINO_KOPT_MMC0=y
BR2_PACKAGE_THINGINO_KOPT_MMC0_PB_4BIT=y
BR2_PACKAGE_THINGINO_KOPT_MMC1=y
BR2_PACKAGE_THINGINO_KOPT_MMC1_PC_4BIT=y
BR2_PACKAGE_WIFI=y
BR2_PACKAGE_WIFI_RTL8189FS=y
# 添加 htop
# === 常用工具 ===
BR2_PACKAGE_HTOP=y
BR2_PACKAGE_SCREEN=y
# 安装网络工具集
BR2_PACKAGE_BUSYBOX_SHOW_OTHERS=y
BR2_PACKAGE_ZIP=y
BR2_PACKAGE_UNZIP=y
BR2_PACKAGE_WGET=y
BR2_PACKAGE_OPENSSL=y
BR2_PACKAGE_CA_CERTIFICATES=y
BR2_PACKAGE_THINGINO_SSL_MBEDTLS=y
# 安装交互式 FTP 客户端
##BR2_PACKAGE_TNFTP=y
# FTP/SFTP 客户端
##BR2_PACKAGE_LFTP=y
##BR2_PACKAGE_LFTP_PROTO_FTP=y
##BR2_PACKAGE_LFTP_PROTO_SFTP=y
# ZeroTier VPN
# BR2_PACKAGE_THINGINO_VPN_WIREGUARD is not set
#BR2_PACKAGE_THINGINO_VPN_ZEROTIER=y
#BR2_INSTALL_LIBSTDCPP=y
#BR2_THINGINO_LIBSTDCPP=y
## === 常用工具 ===
#BR2_PACKAGE_HTOP=y
#BR2_PACKAGE_SCREEN=y
## telnet 客户端 (很小)
#BR2_PACKAGE_BUSYBOX_SHOW_OTHERS=y
#BR2_PACKAGE_TELNET=y
## FTP/SFTP 客户端 (复用已有的 C++ 库)
#BR2_PACKAGE_LFTP=y
#BR2_PACKAGE_LFTP_PROTO_FTP=y
#BR2_PACKAGE_LFTP_PROTO_SFTP=y
## ZeroTier VPN
## BR2_PACKAGE_THINGINO_VPN_WIREGUARD is not set
#BR2_PACKAGE_THINGINO_VPN_ZEROTIER=y
#BR2_INSTALL_LIBSTDCPP=y
#BR2_THINGINO_LIBSTDCPP=y
####
#
BR2_SENSOR_1_NAME="jxf23"
BR2_THINGINO_AUDIO=y
BR2_THINGINO_BUTTON=y
BR2_THINGINO_DFU=y
BR2_THINGINO_ISPMEM_MB=15
BR2_THINGINO_LED_B_ACTIVE_LOW=y
BR2_THINGINO_LED_B_GPIO=39
BR2_THINGINO_LED_Y_ACTIVE_LOW=y
BR2_THINGINO_LED_Y_GPIO=38
BR2_THINGINO_RMEM_MB=15
BR2_THINGINO_SDCARD=y
FLASH_SIZE_MB=16
```
